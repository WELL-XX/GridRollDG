## Kconfig
```kconfig
# SPDX-License-Identifier: MIT
config GRIDROLLDG_PAW3222
    bool "GridRollDG PAW3222 half-duplex GPIO input driver"
    default y if DT_HAS_PANDAKB_PAW3222_SDIO_ENABLED
    depends on GPIO && INPUT

config GRIDROLLDG_PAW3222_LOG_LEVEL
    int "PAW3222 log level"
    range 0 4
    default 1
    depends on GRIDROLLDG_PAW3222

config GRIDROLLDG_WHEEL
    bool "One HID wheel tick per encoder detent"
    default y if DT_HAS_WELLXX_BEHAVIOR_WHEEL_ENABLED
    depends on ZMK_POINTING && INPUT
```

## boards/arm/gridrolldg_e73/Kconfig.board
```kconfig
# SPDX-License-Identifier: MIT
config BOARD_GRIDROLLDG_E73
    bool "GridRollDG E73-2G4M08S1CX"
    depends on SOC_NRF52840_QIAA
```

## boards/arm/gridrolldg_e73/Kconfig.defconfig
```kconfig
# SPDX-License-Identifier: MIT
if BOARD_GRIDROLLDG_E73
config BOARD
    default "gridrolldg_e73"
config BT_CTLR
    default BT
if USB_DEVICE_STACK
config USB_NRFX
    default y
endif
endif
```

## boards/arm/gridrolldg_e73/gridrolldg_e73_defconfig
```kconfig
# SPDX-License-Identifier: MIT
CONFIG_SOC_SERIES_NRF52X=y
CONFIG_SOC_NRF52840_QIAA=y
CONFIG_BOARD_GRIDROLLDG_E73=y
CONFIG_ARM_MPU=y
CONFIG_PINCTRL=y
CONFIG_GPIO=y
CONFIG_GPIO_AS_PINRESET=y
CONFIG_NFCT_PINS_AS_GPIOS=y
CONFIG_CLOCK_CONTROL_NRF_K32SRC_RC=y
CONFIG_CLOCK_CONTROL_NRF_K32SRC_250PPM=y
CONFIG_USE_DT_CODE_PARTITION=y
CONFIG_BUILD_OUTPUT_UF2=y
CONFIG_BUILD_OUTPUT_HEX=y
CONFIG_MPU_ALLOW_FLASH_WRITE=y
CONFIG_FLASH=y
CONFIG_FLASH_PAGE_LAYOUT=y
CONFIG_FLASH_MAP=y
CONFIG_NVS=y
CONFIG_SETTINGS_NVS=y
CONFIG_ZMK_BLE=y
CONFIG_ZMK_USB=y
```

## boards/shields/gridrolldg/Kconfig.defconfig
```kconfig
# SPDX-License-Identifier: MIT
if SHIELD_GRIDROLLDG_LEFT || SHIELD_GRIDROLLDG_RIGHT
config ZMK_KEYBOARD_NAME
    default "GridRollDG"
config ZMK_SPLIT
    default y
endif
if SHIELD_GRIDROLLDG_RIGHT
config ZMK_SPLIT_ROLE_CENTRAL
    default y
endif
```

## boards/shields/gridrolldg/Kconfig.shield
```kconfig
# SPDX-License-Identifier: MIT
config SHIELD_GRIDROLLDG_LEFT
    def_bool $(shields_list_contains,gridrolldg_left)
config SHIELD_GRIDROLLDG_RIGHT
    def_bool $(shields_list_contains,gridrolldg_right)
```

## config/west.yml
```yaml
manifest:
  remotes:
    - name: zmkfirmware
      url-base: https://github.com/zmkfirmware
  projects:
    - name: zmk
      remote: zmkfirmware
      revision: edf5c0814fd3ea202e43aad2d68fd32e882a518c
      import: app/west.yml
    - name: zephyr
      remote: zmkfirmware
      revision: dacab4875df72109b96cc8977547a0dc04875bcd
      import:
        name-blocklist:
          - ci-tools
          - hal_altera
          - hal_cypress
          - hal_infineon
          - hal_microchip
          - hal_nxp
          - hal_openisa
          - hal_silabs
          - hal_xtensa
          - hal_st
          - hal_ti
          - loramac-node
          - mcuboot
          - mcumgr
          - net-tools
          - openthread
          - edtt
          - trusted-firmware-m
  self:
    path: config
```

## dts/bindings/behaviors/wellxx,behavior-wheel.yaml
```yaml
description: One immediate mouse wheel tick, without timed mouse-key acceleration
compatible: "wellxx,behavior-wheel"
include: zero_param.yaml
properties:
  delta:
    type: int
    required: true
```

## dts/bindings/input/pandakb,paw3222-sdio.yaml
```yaml
description: PAW3222 local input device with a released, half-duplex SDIO line
compatible: "pandakb,paw3222-sdio"
include: base.yaml
properties:
  sclk-gpios: {type: phandle-array, required: true}
  sdio-gpios: {type: phandle-array, required: true}
  cs-gpios: {type: phandle-array, required: true}
  motion-gpios: {type: phandle-array, required: true}
  res-cpi:
    type: int
    default: 988
    description: Physical sensor CPI (608 to 4826 in steps of 38); ZMK input processors scale the pointer/scroll output.
  clock-half-period-us: {type: int, default: 5}
  turnaround-us: {type: int, default: 100}
  transaction-gap-us: {type: int, default: 50}
  poll-interval-ms: {type: int, default: 5}
```
